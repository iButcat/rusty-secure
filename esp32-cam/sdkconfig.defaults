## esp32-cam/sdkconfig.defaults
```kconfig
# Rust often needs a bit of an extra main task stack size compared to C (the default is 3K)
CONFIG_ESP_MAIN_TASK_STACK_SIZE=40960

# Use this to set FreeRTOS kernel tick frequency to 1000 Hz (100 Hz by default).
# This allows to use 1 ms granuality for thread sleeps (10 ms by default).
#CONFIG_FREERTOS_HZ=1000

# Workaround for https://github.com/espressif/esp-idf/issues/7631
#CONFIG_MBEDTLS_CERTIFICATE_BUNDLE=n
#CONFIG_MBEDTLS_CERTIFICATE_BUNDLE_DEFAULT_FULL=n

CONFIG_ESP32_SPIRAM_SUPPORT=y
CONFIG_SPIRAM_USE_MALLOC=y
CONFIG_SPIRAM_CACHE_WORKAROUND=y
CONFIG_SPIRAM_IGNORE_NOTFOUND=y

CONFIG_ESP_TLS_INSECURE=y
CONFIG_ESP_TLS_SKIP_SERVER_CERT_VERIFY=y

CONFIG_HTTPD_MAX_REQ_HDR_LEN=1024
CONFIG_ESP_HTTP_SERVER_ENABLE=y

# Halt on panic instead of rebooting - lets us see the actual crash reason
CONFIG_ESP_SYSTEM_PANIC_PRINT_HALT=y

# Disable brownout detection - ESP32-CAM boards brownout during RF calibration
# due to insufficient power delivery on cheap USB supplies
CONFIG_ESP_BROWNOUT_DET=n
```
